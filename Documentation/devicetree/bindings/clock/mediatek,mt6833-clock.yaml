## Documentation/devicetree/bindings/power/supply/mt6360_charger.yaml
```yaml
# SPDX-License-Identifier: (GPL-2.0-only OR BSD-2-Clause)
%YAML 1.2
---
$id: http://devicetree.org/schemas/power/supply/mt6360_charger.yaml#
$schema: http://devicetree.org/meta-schemas/core.yaml#

title: Battery charger driver for MT6360 PMIC from MediaTek Integrated.

maintainers:
  - Gene Chen <gene_chen@richtek.com>

description: |
  This module is part of the MT6360 MFD device.
  Provides Battery Charger, Boost for OTG devices and BC1.2 detection.

allOf:
  - $ref: power-supply.yaml#

properties:
  compatible:
    const: mediatek,mt6360-chg

  richtek,vinovp-microvolt:
    description: Maximum CHGIN regulation voltage in uV.
    enum: [ 5500000, 6500000, 11000000, 14500000 ]

  monitored-battery:
    description:
      The battery being charged. Its constant charge current and voltage, which
      also become the most that may be set, and its precharge and termination
      currents are applied.

  io-channels:
    maxItems: 1

  io-channel-names:
    items:
      - const: battery-temp
    description:
      The battery temperature, in millicelsius, when the battery thermistor is
      not on the MT6360's TS pin. With it the charger charges the monitored
      battery only within its operating temperature range, and at its alert
      temperatures with at most its alert charge current and voltage.

  usb-otg-vbus-regulator:
    type: object
    description: OTG boost regulator.
    $ref: /schemas/regulator/regulator.yaml#
    unevaluatedProperties: false

required:
  - compatible

additionalProperties: false

examples:
  - |
    mt6360_charger: charger {
      compatible = "mediatek,mt6360-chg";
      richtek,vinovp-microvolt = <14500000>;

      otg_vbus_regulator: usb-otg-vbus-regulator {
        regulator-name = "usb-otg-vbus";
        regulator-min-microvolt = <4425000>;
        regulator-max-microvolt = <5825000>;
      };
    };
...
```

## Documentation/devicetree/bindings/regulator/willsemi,wl2866d.yaml
```yaml
# SPDX-License-Identifier: (GPL-2.0-only OR BSD-2-Clause)
%YAML 1.2
---
$id: http://devicetree.org/schemas/regulator/willsemi,wl2866d.yaml#
$schema: http://devicetree.org/meta-schemas/core.yaml#

title: Will Semiconductor WL2866D camera PMIC

maintainers:
  - Rui Cao <i@udp0.com>

description:
  The WL2866D is an I2C controlled power management IC for camera modules
  with four low-dropout regulators. DVDD1 and DVDD2 (0.6 V to 1.8 V) are fed
  from VIN1, AVDD1 and AVDD2 (1.2 V to 4.3 V) from VIN2, which also biases the
  chip.

properties:
  compatible:
    const: willsemi,wl2866d

  reg:
    maxItems: 1

  vin1-supply:
    description: Input of the DVDD regulators.

  vin2-supply:
    description: Input of the AVDD regulators and the bias supply.

  regulators:
    type: object
    additionalProperties: false

    patternProperties:
      "^[ad]vdd[12]$":
        type: object
        $ref: regulator.yaml#
        unevaluatedProperties: false

required:
  - compatible
  - reg
  - regulators

additionalProperties: false

examples:
  - |
    i2c {
        #address-cells = <1>;
        #size-cells = <0>;

        pmic@28 {
            compatible = "willsemi,wl2866d";
            reg = <0x28>;

            regulators {
                dvdd2 {
                    regulator-name = "cam_dvdd2";
                    regulator-min-microvolt = <1200000>;
                    regulator-max-microvolt = <1200000>;
                    regulator-active-discharge = <1>;
                };

                avdd2 {
                    regulator-name = "cam_avdd2";
                    regulator-min-microvolt = <2800000>;
                    regulator-max-microvolt = <2800000>;
                    regulator-active-discharge = <1>;
                };
            };
        };
    };
...
```

## Documentation/devicetree/bindings/sound/mediatek,mt6359-accdet.yaml
```yaml
# SPDX-License-Identifier: (GPL-2.0-only OR BSD-2-Clause)
%YAML 1.2
---
$id: http://devicetree.org/schemas/sound/mediatek,mt6359-accdet.yaml#
$schema: http://devicetree.org/meta-schemas/core.yaml#

title: MediaTek MT6359 accessory detection

maintainers:
  - Rui Cao <i@udp0.com>

description:
  The accessory detection (accdet) block of the MT6359 PMIC detects
  headset plug-in and removal, the headset microphone and the headset
  buttons. It is a child node of the PMIC and must be named accdet.

properties:
  compatible:
    const: mediatek,mt6359-accdet

  io-channels:
    maxItems: 1
    description:
      The accdet channel of the PMIC AUXADC, which measures the voltage the
      headset buttons pull the microphone line to.

  io-channel-names:
    const: pmic_accdet

  mediatek,mic-vol:
    $ref: /schemas/types.yaml#/definitions/uint32
    description: Microphone bias voltage setting (register value).
    default: 8

  mediatek,plugout-debounce:
    $ref: /schemas/types.yaml#/definitions/uint32
    description: Plug-out debounce setting (register value).
    default: 1

  mediatek,mic-mode:
    $ref: /schemas/types.yaml#/definitions/uint32
    description: Microphone mode, 1 ACC, 2 DCC, 6 DCC with internal bias.
    enum: [1, 2, 6]
    default: 2

  mediatek,pwm-deb-setting:
    $ref: /schemas/types.yaml#/definitions/uint32-array
    description:
      PWM width and threshold, fall and rise delay, the debounce times of
      the detection states and the EINT PWM settings, as register values.
    minItems: 15
    maxItems: 15

  mediatek,eint-level-pol:
    $ref: /schemas/types.yaml#/definitions/uint32
    description: EINT trigger level.
    default: 8

  mediatek,eint-use-ap:
    $ref: /schemas/types.yaml#/definitions/uint32
    description: 0 to use the PMIC EINT, 1 to use an AP GPIO EINT.
    enum: [0, 1]
    default: 0

  mediatek,eint-detect-mode:
    $ref: /schemas/types.yaml#/definitions/uint32
    description: EINT detection mode (register value).
    default: 4

  mediatek,eint-num:
    $ref: /schemas/types.yaml#/definitions/uint32
    description: PMIC EINT used, 0 EINT0, 1 EINT1, 2 both.
    enum: [0, 1, 2]
    default: 0

  mediatek,eint-trig-mode:
    $ref: /schemas/types.yaml#/definitions/uint32
    description: 0 to trigger the EINT from the GPIO, 1 from the inverter.
    enum: [0, 1]
    default: 0

  mediatek,eint-use-ext-res:
    $ref: /schemas/types.yaml#/definitions/uint32
    description: 1 if the EINT uses an external pull resistor.
    enum: [0, 1]
    default: 0

  mediatek,eint-comp-vth:
    $ref: /schemas/types.yaml#/definitions/uint32
    description: EINT comparator threshold (register value).
    default: 0

  mediatek,key-mode:
    $ref: /schemas/types.yaml#/definitions/uint32
    description: 0 three keys, 1 four keys, 2 three keys (CDD thresholds).
    enum: [0, 1, 2]
    default: 0

  mediatek,three-key-thr:
    $ref: /schemas/types.yaml#/definitions/uint32-array
    description: Button voltage thresholds in mV for three keys.
    minItems: 4
    maxItems: 4

  mediatek,four-key-thr:
    $ref: /schemas/types.yaml#/definitions/uint32-array
    description: Button voltage thresholds in mV for four keys.
    minItems: 5
    maxItems: 5

  mediatek,tri-key-cdd-thr:
    $ref: /schemas/types.yaml#/definitions/uint32-array
    description: Button voltage thresholds in mV for three keys, CDD.
    minItems: 4
    maxItems: 4

required:
  - compatible

additionalProperties: false

examples:
  - |
    accdet {
        compatible = "mediatek,mt6359-accdet";
        mediatek,mic-mode = <2>;
        mediatek,eint-trig-mode = <1>;
        mediatek,three-key-thr = <0 80 220 400>;
    };
...
```

## Documentation/devicetree/bindings/sound/mediatek,mt6833-mt6359.yaml
```yaml
# SPDX-License-Identifier: (GPL-2.0-only OR BSD-2-Clause)
%YAML 1.2
---
$id: http://devicetree.org/schemas/sound/mediatek,mt6833-mt6359.yaml#
$schema: http://devicetree.org/meta-schemas/core.yaml#

title: MediaTek MT6833 sound card with the MT6359 codec

maintainers:
  - Rui Cao <i@udp0.com>

description:
  Sound card for MT6833 boards whose outputs and analog microphones all
  go through the MT6359 PMIC codec. A speaker amplifier fed from one of
  the codec's analog outputs is an auxiliary device of the card.

allOf:
  - $ref: sound-card-common.yaml#

properties:
  compatible:
    const: mediatek,mt6833-mt6359-sound

  audio-routing:
    description:
      Connections between the card widgets ("Headphone", "Headset Mic",
      "Speaker", "Earpiece"), the MT6359 codec pins and the auxiliary
      devices, whose widget names carry their sound-name-prefix.

  aux-devs:
    $ref: /schemas/types.yaml#/definitions/phandle-array
    description: Analog amplifiers and other auxiliary devices of the card.

  mediatek,platform:
    $ref: /schemas/types.yaml#/definitions/phandle
    description: The phandle of the MT6833 audio front end.

  mediatek,accdet:
    $ref: /schemas/types.yaml#/definitions/phandle
    description:
      The phandle of the MT6359 accessory detection block, if it is wired
      to the headset jack.

  pinctrl-names:
    items:
      - const: aud_clk_mosi_off
      - const: aud_clk_mosi_on
      - const: aud_dat_mosi_off
      - const: aud_dat_mosi_on
      - const: aud_dat_miso_off
      - const: aud_dat_miso_on

  pinctrl-0: true
  pinctrl-1: true
  pinctrl-2: true
  pinctrl-3: true
  pinctrl-4: true
  pinctrl-5: true

required:
  - compatible
  - audio-routing
  - mediatek,platform
  - pinctrl-names

unevaluatedProperties: false

examples:
  - |
    sound {
        compatible = "mediatek,mt6833-mt6359-sound";
        model = "Example";
        mediatek,platform = <&afe>;
        mediatek,accdet = <&accdet>;
        aux-devs = <&speaker_amp>;
        audio-routing =
            "Headphone", "Headphone L",
            "Headphone", "Headphone R",
            "AIN1", "Headset Mic",
            "Earpiece", "Receiver",
            "Speaker Amp IN", "LINEOUT L",
            "Speaker", "Speaker Amp OUT";
        pinctrl-names = "aud_clk_mosi_off", "aud_clk_mosi_on",
                        "aud_dat_mosi_off", "aud_dat_mosi_on",
                        "aud_dat_miso_off", "aud_dat_miso_on";
        pinctrl-0 = <&aud_clk_mosi_off>;
        pinctrl-1 = <&aud_clk_mosi_on>;
        pinctrl-2 = <&aud_dat_mosi_off>;
        pinctrl-3 = <&aud_dat_mosi_on>;
        pinctrl-4 = <&aud_dat_miso_off>;
        pinctrl-5 = <&aud_dat_miso_on>;
    };
...
```

## Documentation/devicetree/bindings/sound/si-in,sia8159.yaml
```yaml
# SPDX-License-Identifier: (GPL-2.0-only OR BSD-2-Clause)
%YAML 1.2
---
$id: http://devicetree.org/schemas/sound/si-in,sia8159.yaml#
$schema: http://devicetree.org/meta-schemas/core.yaml#

title: SI-IN SIA8159 speaker amplifier

maintainers:
  - Rui Cao <i@udp0.com>

description:
  The SIA8159 is a class-D/K mono speaker amplifier with an analog line
  level input. It is switched on and off and set up over I2C; it has no
  digital audio interface.

allOf:
  - $ref: dai-common.yaml#

properties:
  compatible:
    const: si-in,sia8159

  reg:
    maxItems: 1

  sound-name-prefix: true

required:
  - compatible
  - reg

unevaluatedProperties: false

examples:
  - |
    i2c {
        #address-cells = <1>;
        #size-cells = <0>;

        audio-amplifier@29 {
            compatible = "si-in,sia8159";
            reg = <0x29>;
            sound-name-prefix = "Speaker Amp";
        };
    };
...
```

## drivers/media/platform/mediatek/isp6s/Kconfig
```kconfig
# SPDX-License-Identifier: GPL-2.0-only
config VIDEO_MTK_SENINF_MT6833
	tristate "MediaTek MT6833 sensor interface (SENINF)"
	depends on V4L_PLATFORM_DRIVERS
	depends on VIDEO_DEV && OF
	depends on ARCH_MEDIATEK || COMPILE_TEST
	select MEDIA_CONTROLLER
	select VIDEO_V4L2_SUBDEV_API
	select V4L2_FWNODE
	select GENERIC_PHY
	help
	  Enable this to support the CSI-2 receivers of the MediaTek MT6833
	  sensor interface, which pass camera sensor frames on to the camera
	  DMA engines (camsv).

	  To compile this driver as a module, choose M here: the
	  module will be called mtk-seninf-mt6833.

config VIDEO_MTK_CAMSV_MT6833
	tristate "MediaTek MT6833 camera DMA (camsv)"
	depends on VIDEO_MTK_SENINF_MT6833
	select VIDEOBUF2_DMA_CONTIG
	help
	  Enable this to capture frames from the MediaTek MT6833 sensor
	  interface into memory through the camsv DMA engines.

	  To compile this driver as a module, choose M here: the
	  module will be called mtk-camsv-mt6833.
```
