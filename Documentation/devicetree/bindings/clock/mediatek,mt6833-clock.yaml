## Documentation/devicetree/bindings/media/i2c/smartsens,sc202cs.yaml
```yaml
# SPDX-License-Identifier: (GPL-2.0-only OR BSD-2-Clause)
%YAML 1.2
---
$id: http://devicetree.org/schemas/media/i2c/smartsens,sc202cs.yaml#
$schema: http://devicetree.org/meta-schemas/core.yaml#

title: SmartSens SC202CS 2 Mpixel monochrome MIPI CSI-2 sensor

maintainers:
  - Rui Cao <i@udp0.com>

description:
  The SC202CS is a 1600x1200 monochrome image sensor with a single-lane MIPI
  CSI-2 D-PHY data interface and a CCI (I2C compatible) control bus. Its
  digital core supply can be generated inside the sensor.

allOf:
  - $ref: /schemas/media/video-interface-devices.yaml#

properties:
  compatible:
    const: smartsens,sc202cs

  reg:
    maxItems: 1

  clocks:
    description: MCLK, 24 MHz.
    maxItems: 1

  dovdd-supply:
    description: Digital I/O supply, 1.8 V.

  avdd-supply:
    description: Analog supply, 2.8 V.

  dvdd-supply:
    description: Digital core supply, 1.2 V, if not generated inside the sensor.

  reset-gpios:
    description: The XSHUTDN pin, active low.
    maxItems: 1

  port:
    $ref: /schemas/graph.yaml#/$defs/port-base
    additionalProperties: false

    properties:
      endpoint:
        $ref: /schemas/media/video-interfaces.yaml#
        unevaluatedProperties: false

        properties:
          data-lanes:
            items:
              - const: 1

          link-frequencies: true

        required:
          - data-lanes
          - link-frequencies

    required:
      - endpoint

required:
  - compatible
  - reg
  - clocks
  - dovdd-supply
  - avdd-supply
  - port

unevaluatedProperties: false

examples:
  - |
    #include <dt-bindings/gpio/gpio.h>

    i2c {
        #address-cells = <1>;
        #size-cells = <0>;

        camera-sensor@36 {
            compatible = "smartsens,sc202cs";
            reg = <0x36>;
            clocks = <&camera_mclk>;
            reset-gpios = <&pio 60 GPIO_ACTIVE_LOW>;
            dovdd-supply = <&vcamio>;
            avdd-supply = <&cam_avdd>;

            port {
                endpoint {
                    data-lanes = <1>;
                    link-frequencies = /bits/ 64 <360000000>;
                    remote-endpoint = <&csi_in>;
                };
            };
        };
    };
...
```

## Documentation/devicetree/bindings/media/mediatek,mt6833-camsv.yaml
```yaml
# SPDX-License-Identifier: (GPL-2.0-only OR BSD-2-Clause)
%YAML 1.2
---
$id: http://devicetree.org/schemas/media/mediatek,mt6833-camsv.yaml#
$schema: http://devicetree.org/meta-schemas/core.yaml#

title: MediaTek MT6833 camera DMA engine (camsv)

maintainers:
  - Rui Cao <i@udp0.com>

description:
  A camsv instance takes one SENINF output, crops it in its timing generator
  and writes it to memory through its IMGO DMA, behind the M4U.

properties:
  compatible:
    const: mediatek,mt6833-camsv

  reg:
    maxItems: 1

  interrupts:
    maxItems: 1

  clocks:
    items:
      - description: CAM clock gate in camsys
      - description: CAMTG clock gate in camsys
      - description: Clock gate of the camsv pair in camsys

  clock-names:
    items:
      - const: cam
      - const: camtg
      - const: camsv

  power-domains:
    maxItems: 1

  iommus:
    maxItems: 1

  port:
    $ref: /schemas/graph.yaml#/properties/port
    description: Input from a SENINF output.

required:
  - compatible
  - reg
  - interrupts
  - clocks
  - clock-names
  - power-domains
  - iommus
  - port

additionalProperties: false

examples:
  - |
    #include <dt-bindings/clock/mediatek,mt6833-clk.h>
    #include <dt-bindings/interrupt-controller/arm-gic.h>
    #include <dt-bindings/power/mediatek,mt6833-power.h>

    soc {
        #address-cells = <2>;
        #size-cells = <2>;

        camsv@1a092000 {
            compatible = "mediatek,mt6833-camsv";
            reg = <0 0x1a092000 0 0x1000>;
            interrupts = <GIC_SPI 327 IRQ_TYPE_LEVEL_HIGH>;
            clocks = <&camsys CLK_CAM_M_CAM>,
                     <&camsys CLK_CAM_M_CAMTG>,
                     <&camsys CLK_CAM_M_CAMSV1>;
            clock-names = "cam", "camtg", "camsv";
            iommus = <&iommu 6>;
            power-domains = <&spm MT6833_POWER_DOMAIN_CAM>;

            port {
                endpoint {
                    remote-endpoint = <&seninf_camsv2>;
                };
            };
        };
    };
```

## Documentation/devicetree/bindings/media/mediatek,mt6833-seninf.yaml
```yaml
# SPDX-License-Identifier: (GPL-2.0-only OR BSD-2-Clause)
%YAML 1.2
---
$id: http://devicetree.org/schemas/media/mediatek,mt6833-seninf.yaml#
$schema: http://devicetree.org/meta-schemas/core.yaml#

title: MediaTek MT6833 sensor interface (SENINF)

maintainers:
  - Rui Cao <i@udp0.com>

description:
  The SENINF has six CSI-2 receivers, seninf1 to seninf6, each with a test
  pattern generator, and 13 outputs (cam_mux) towards the raw ISPs (0 to 2)
  and the camera DMA engines (3 and up, camsv). Receivers 1, 3 and 5 take the
  A port of CSI port pair 0, 1 and 2, or the whole pair with more than two
  data lanes; receivers 2, 4 and 6 take the B port.

properties:
  compatible:
    const: mediatek,mt6833-seninf

  reg:
    maxItems: 1

  clocks:
    items:
      - description: SENINF clock gate in camsys
      - description: seninf_sel clock mux
      - description: seninf1_sel clock mux
      - description: seninf2_sel clock mux

  clock-names:
    items:
      - const: camsys
      - const: seninf
      - const: seninf1
      - const: seninf2

  power-domains:
    maxItems: 1

  phys:
    maxItems: 9

  phy-names:
    items:
      - const: csi0
      - const: csi0a
      - const: csi0b
      - const: csi1
      - const: csi1a
      - const: csi1b
      - const: csi2
      - const: csi2a
      - const: csi2b

  ports:
    $ref: /schemas/graph.yaml#/properties/ports
    description:
      Ports 0 to 5 are the inputs of receivers seninf1 to seninf6, ports 6 to
      18 the outputs cam_mux 0 to 12.

    patternProperties:
      "^port@[0-5]$":
        $ref: /schemas/graph.yaml#/$defs/port-base
        unevaluatedProperties: false

        properties:
          endpoint:
            $ref: video-interfaces.yaml#
            unevaluatedProperties: false

            properties:
              data-lanes:
                minItems: 1
                maxItems: 4

            required:
              - data-lanes

      "^port@([6-9a-f]|1[0-2])$":
        $ref: /schemas/graph.yaml#/properties/port

required:
  - compatible
  - reg
  - clocks
  - clock-names
  - power-domains
  - phys
  - phy-names
  - ports

additionalProperties: false

examples:
  - |
    #include <dt-bindings/clock/mediatek,mt6833-clk.h>
    #include <dt-bindings/power/mediatek,mt6833-power.h>

    soc {
        #address-cells = <2>;
        #size-cells = <2>;

        seninf@1a004000 {
            compatible = "mediatek,mt6833-seninf";
            reg = <0 0x1a004000 0 0x6000>;
            clocks = <&camsys CLK_CAM_M_SENINF>,
                     <&topckgen CLK_TOP_SENINF_SEL>,
                     <&topckgen CLK_TOP_SENINF1_SEL>,
                     <&topckgen CLK_TOP_SENINF2_SEL>;
            clock-names = "camsys", "seninf", "seninf1", "seninf2";
            power-domains = <&spm MT6833_POWER_DOMAIN_CAM>;
            phys = <&csi0_rx 0>, <&csi0_rx 1>, <&csi0_rx 2>,
                   <&csi1_rx 0>, <&csi1_rx 1>, <&csi1_rx 2>,
                   <&csi2_rx 0>, <&csi2_rx 1>, <&csi2_rx 2>;
            phy-names = "csi0", "csi0a", "csi0b",
                        "csi1", "csi1a", "csi1b",
                        "csi2", "csi2a", "csi2b";

            ports {
                #address-cells = <1>;
                #size-cells = <0>;

                port@1 {
                    reg = <1>;

                    endpoint {
                        data-lanes = <1>;
                        remote-endpoint = <&sensor_out>;
                    };
                };

                port@b {
                    reg = <11>;

                    endpoint {
                        remote-endpoint = <&camsv2_in>;
                    };
                };
            };
        };
    };
```

## Documentation/devicetree/bindings/phy/mediatek,mt6833-csi-rx.yaml
```yaml
# SPDX-License-Identifier: (GPL-2.0-only OR BSD-2-Clause)
%YAML 1.2
---
$id: http://devicetree.org/schemas/phy/mediatek,mt6833-csi-rx.yaml#
$schema: http://devicetree.org/meta-schemas/core.yaml#

title: MediaTek MT6833 MIPI CSI-2 receiver D-PHY

maintainers:
  - Rui Cao <i@udp0.com>

description:
  Each CSI port pair of the MT6833 has an analog receiver half for each of its
  A and B ports and a D-PHY lane controller they share. The pair is used as
  one port with four data lanes over both halves, or as two independent ports
  of up to two data lanes each. The PHYs feed the SENINF CSI-2 receivers.

properties:
  compatible:
    const: mediatek,mt6833-csi-rx

  reg:
    maxItems: 1

  nvmem-cells:
    items:
      - description: Termination impedance calibration word.

  nvmem-cell-names:
    items:
      - const: calibration

  '#phy-cells':
    const: 1
    description:
      0 for the whole pair (up to 4 data lanes), 1 for the A port, 2 for the
      B port (up to 2 data lanes each).

required:
  - compatible
  - reg
  - '#phy-cells'

additionalProperties: false

examples:
  - |
    soc {
        #address-cells = <2>;
        #size-cells = <2>;

        phy@11c80000 {
            compatible = "mediatek,mt6833-csi-rx";
            reg = <0 0x11c80000 0 0x4000>;
            nvmem-cells = <&csi0_rx_calib>;
            nvmem-cell-names = "calibration";
            #phy-cells = <1>;
        };
    };
```

## Documentation/devicetree/bindings/pinctrl/mediatek,mt6833-pinctrl.yaml
```yaml
# SPDX-License-Identifier: (GPL-2.0-only OR BSD-2-Clause)
%YAML 1.2
---
$id: http://devicetree.org/schemas/pinctrl/mediatek,mt6833-pinctrl.yaml#
$schema: http://devicetree.org/meta-schemas/core.yaml#

title: MediaTek MT6833 Pin Controller

maintainers:
  - Rui Cao <i@udp0.com>

description:
  The MediaTek's MT6833 Pin controller is used to control SoC pins.

properties:
  compatible:
    const: mediatek,mt6833-pinctrl

  reg:
    items:
      - description: gpio base
      - description: rb group IO
      - description: bm group IO
      - description: br group IO
      - description: lm group IO
      - description: bl group IO
      - description: rt group IO
      - description: eint controller base

  reg-names:
    items:
      - const: base
      - const: rb
      - const: bm
      - const: br
      - const: lm
      - const: bl
      - const: rt
      - const: eint

  interrupts:
    maxItems: 1

  interrupt-controller: true

  '#interrupt-cells':
    const: 2

  gpio-controller: true

  '#gpio-cells':
    const: 2

  gpio-ranges:
    maxItems: 1

  gpio-line-names: true

# PIN CONFIGURATION NODES
patternProperties:
  '-pins$':
    type: object
    additionalProperties: false

    patternProperties:
      '^pins':
        type: object
        allOf:
          - $ref: /schemas/pinctrl/pincfg-node.yaml
          - $ref: /schemas/pinctrl/pinmux-node.yaml
        additionalProperties: false
        description:
          A pinctrl node should contain at least one subnodes representing the
          pinctrl groups available on the machine. Each subnode will list the
          pins it needs, and how they should be configured, with regard to muxer
          configuration, pullups, drive strength, input enable/disable and input
          schmitt.

        properties:
          pinmux:
            description:
              Integer array, represents gpio pin number and mux setting.
              Supported pin number and mux varies for different SoCs, and are
              defined as macros in arch/arm64/boot/dts/mediatek/mt6833-pinfunc.h
              for this SoC.

          drive-strength:
            enum: [2, 4, 6, 8, 10, 12, 14, 16]

          drive-strength-microamp:
            enum: [125, 250, 500, 1000]

          bias-pull-down:
            oneOf:
              - type: boolean
                description: normal pull down.
              - enum: [100, 101, 102, 103]
                description: PUPD/R1/R0 pull down type. See MTK_PUPD_SET_R1R0_
                  defines in dt-bindings/pinctrl/mt65xx.h.

          bias-pull-up:
            oneOf:
              - type: boolean
                description: normal pull up.
              - enum: [100, 101, 102, 103]
                description: PUPD/R1/R0 pull up type. See MTK_PUPD_SET_R1R0_
                  defines in dt-bindings/pinctrl/mt65xx.h.

          bias-disable: true

          output-high: true

          output-low: true

          input-enable: true

          input-disable: true

          input-schmitt-enable: true

          input-schmitt-disable: true

        required:
          - pinmux

required:
  - compatible
  - reg
  - interrupts
  - interrupt-controller
  - '#interrupt-cells'
  - gpio-controller
  - '#gpio-cells'
  - gpio-ranges

additionalProperties: false

examples:
  - |
    #include <dt-bindings/pinctrl/mt65xx.h>
    #include <dt-bindings/interrupt-controller/arm-gic.h>
    #define PINMUX_GPIO97__FUNC_SCL0 (MTK_PIN_NO(97) | 1)
    #define PINMUX_GPIO98__FUNC_SDA0 (MTK_PIN_NO(98) | 1)

    pio: pinctrl@10005000 {
        compatible = "mediatek,mt6833-pinctrl";
        reg = <0x10005000 0x1000>,
              <0x11c30000 0x1000>,
              <0x11d10000 0x1000>,
              <0x11d40000 0x1000>,
              <0x11e20000 0x1000>,
              <0x11e60000 0x1000>,
              <0x11ea0000 0x1000>,
              <0x1000b000 0x1000>;
        reg-names = "base", "rb", "bm", "br", "lm", "bl", "rt", "eint";
        gpio-controller;
        #gpio-cells = <2>;
        gpio-ranges = <&pio 0 0 201>;
        interrupt-controller;
        interrupts = <GIC_SPI 212 IRQ_TYPE_LEVEL_HIGH 0>;
        #interrupt-cells = <2>;

        i2c0-pins {
            pins {
                pinmux = <PINMUX_GPIO97__FUNC_SCL0>,
                         <PINMUX_GPIO98__FUNC_SDA0>;
                bias-pull-up;
                drive-strength-microamp = <1000>;
            };
        };
    };
```
