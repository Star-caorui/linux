## Documentation/devicetree/bindings/clock/mediatek,mt6833-clock.yaml
```yaml
# SPDX-License-Identifier: (GPL-2.0-only OR BSD-2-Clause)
%YAML 1.2
---
$id: http://devicetree.org/schemas/clock/mediatek,mt6833-clock.yaml#
$schema: http://devicetree.org/meta-schemas/core.yaml#

title: MediaTek Functional Clock Controllers for MT6833

maintainers:
  - Rui Cao <i@udp0.com>

description:
  The functional clock controllers gate the clocks of the IP blocks in their
  subsystem. The imp_iic_wrap blocks gate the I2C controllers' clocks, mfgcfg
  the GPU's. mfgcfg sits in a GPU power domain and needs it powered on to be
  accessed. The clock IDs are defined in
  include/dt-bindings/clock/mediatek,mt6833-clk.h.

properties:
  compatible:
    enum:
      - mediatek,mt6833-imp-iic-wrap-c
      - mediatek,mt6833-imp-iic-wrap-e
      - mediatek,mt6833-imp-iic-wrap-n
      - mediatek,mt6833-imp-iic-wrap-s
      - mediatek,mt6833-imp-iic-wrap-w
      - mediatek,mt6833-imp-iic-wrap-ws
      - mediatek,mt6833-mfgcfg

  reg:
    maxItems: 1

  power-domains:
    maxItems: 1

  '#clock-cells':
    const: 1

required:
  - compatible
  - reg
  - '#clock-cells'

allOf:
  - if:
      properties:
        compatible:
          contains:
            const: mediatek,mt6833-mfgcfg
    then:
      required:
        - power-domains
    else:
      properties:
        power-domains: false

additionalProperties: false

examples:
  - |
    clock-controller@11007000 {
        compatible = "mediatek,mt6833-imp-iic-wrap-c";
        reg = <0x11007000 0x1000>;
        #clock-cells = <1>;
    };
```

## Documentation/devicetree/bindings/clock/mediatek,mt6833-sys-clock.yaml
```yaml
# SPDX-License-Identifier: (GPL-2.0-only OR BSD-2-Clause)
%YAML 1.2
---
$id: http://devicetree.org/schemas/clock/mediatek,mt6833-sys-clock.yaml#
$schema: http://devicetree.org/meta-schemas/core.yaml#

title: MediaTek System Clock Controllers for MT6833

maintainers:
  - Rui Cao <i@udp0.com>

description:
  The apmixedsys block provides the PLLs, which run from the SoC's 26 MHz
  crystal. The topckgen block provides the dividers and muxes that feed the
  other IP blocks. The infracfg_ao block gates the clocks of the
  infrastructure and peripheral IP blocks and provides their software resets.
  The mcusys block selects the clock sources of the CPU clusters and the CCI.
  The clock IDs are defined in include/dt-bindings/clock/mediatek,mt6833-clk.h
  and the reset IDs in include/dt-bindings/reset/mediatek,mt6833-resets.h.

properties:
  compatible:
    items:
      - enum:
          - mediatek,mt6833-apmixedsys
          - mediatek,mt6833-infracfg-ao
          - mediatek,mt6833-mcusys
          - mediatek,mt6833-topckgen
      - const: syscon

  reg:
    maxItems: 1

  '#clock-cells':
    const: 1

  '#reset-cells':
    const: 1

required:
  - compatible
  - reg
  - '#clock-cells'

allOf:
  - if:
      properties:
        compatible:
          contains:
            const: mediatek,mt6833-infracfg-ao
    then:
      required:
        - '#reset-cells'
    else:
      properties:
        '#reset-cells': false

additionalProperties: false

examples:
  - |
    clock-controller@10000000 {
        compatible = "mediatek,mt6833-topckgen", "syscon";
        reg = <0x10000000 0x1000>;
        #clock-cells = <1>;
    };

  - |
    clock-controller@10001000 {
        compatible = "mediatek,mt6833-infracfg-ao", "syscon";
        reg = <0x10001000 0x1000>;
        #clock-cells = <1>;
        #reset-cells = <1>;
    };
```

## Documentation/devicetree/bindings/display/bridge/mediatek,mt6382.yaml
```yaml
# SPDX-License-Identifier: (GPL-2.0-only OR BSD-2-Clause)
%YAML 1.2
---
$id: http://devicetree.org/schemas/display/bridge/mediatek,mt6382.yaml#
$schema: http://devicetree.org/meta-schemas/core.yaml#

title: MediaTek MT6382 MIPI DSI to MIPI DSI bridge with DSC

maintainers:
  - Betterr <51264180+Star-caorui@users.noreply.github.com>

description:
  The MT6382 receives uncompressed RGB888 video from a MIPI DSI host over up
  to four D-PHY lanes, buffers it, compresses it with a VESA DSC encoder and
  sends it on over its own MIPI DSI transmitter to a DSC panel. It is
  configured over SPI, LSB first. It also passes its 26 MHz reference clock
  on to an NFC controller.

allOf:
  - $ref: /schemas/display/dsi-controller.yaml#
  - $ref: /schemas/spi/spi-peripheral-props.yaml#

properties:
  compatible:
    const: mediatek,mt6382

  reg:
    maxItems: 1

  spi-max-frequency:
    maximum: 55000000

  spi-lsb-first: true

  clocks:
    maxItems: 1
    description: 26 MHz reference clock

  '#clock-cells':
    const: 0
    description:
      The 26 MHz reference clock as the bridge passes it on to an NFC
      controller, while the NFC controller requests it.

  reset-gpios:
    maxItems: 1

  interrupts:
    maxItems: 1

  ports:
    $ref: /schemas/graph.yaml#/properties/ports

    properties:
      port@0:
        $ref: /schemas/graph.yaml#/properties/port
        description: MIPI DSI input from the SoC's DSI host

      port@1:
        $ref: /schemas/graph.yaml#/properties/port
        description: MIPI DSI output to the panel

    required:
      - port@0
      - port@1

required:
  - compatible
  - reg
  - spi-lsb-first
  - clocks
  - reset-gpios
  - ports

unevaluatedProperties: false

examples:
  - |
    #include <dt-bindings/gpio/gpio.h>

    spi {
        #address-cells = <1>;
        #size-cells = <0>;

        dsi@0 {
            compatible = "mediatek,mt6382";
            reg = <0>;
            spi-max-frequency = <55000000>;
            spi-lsb-first;
            clocks = <&bridge_xo>;
            reset-gpios = <&pio 20 GPIO_ACTIVE_LOW>;
            #clock-cells = <0>;
            #address-cells = <1>;
            #size-cells = <0>;

            ports {
                #address-cells = <1>;
                #size-cells = <0>;

                port@0 {
                    reg = <0>;

                    bridge_in: endpoint {
                        remote-endpoint = <&dsi0_out>;
                    };
                };

                port@1 {
                    reg = <1>;

                    bridge_out: endpoint {
                        remote-endpoint = <&panel_in>;
                    };
                };
            };

            panel@0 {
                compatible = "xiaomi,gold-panel-n17-36-0f-0c";
                reg = <0>;
                vdd-supply = <&panel_dvdd>;
                vci-supply = <&panel_vci>;
                vddio-supply = <&vio18>;
                reset-gpios = <&pio 86 GPIO_ACTIVE_LOW>;

                port {
                    panel_in: endpoint {
                        remote-endpoint = <&bridge_out>;
                    };
                };
            };
        };
    };
```

## Documentation/devicetree/bindings/display/panel/chipone,icna3512.yaml
```yaml
# SPDX-License-Identifier: (GPL-2.0-only OR BSD-2-Clause)
%YAML 1.2
---
$id: http://devicetree.org/schemas/display/panel/chipone,icna3512.yaml#
$schema: http://devicetree.org/meta-schemas/core.yaml#

title: Chipone ICNA3512, ICNA3520 and related display drivers

maintainers:
  - Neil Armstrong <neil.armstrong@linaro.org>

description:
  The Chipone ICNA3512 and ICNA3520 are DDICs connected
  using a MIPI-DSI video interface. The panel n17-36-0f-0c of the Xiaomi
  Redmi Note 13 5G (gold) has a DDIC of the same family, model unknown,
  behind a MediaTek MT6382 bridge.

allOf:
  - $ref: panel-common.yaml#
  - if:
      properties:
        compatible:
          contains:
            const: xiaomi,gold-panel-n17-36-0f-0c
    then:
      properties:
        disp-supply: false
        blvdd-supply: false
    else:
      required:
        - disp-supply
        - blvdd-supply

properties:
  compatible:
    oneOf:
      - items:
          - enum:
              - ayaneo,pocketds-panel-top
              - ayntec,odin2portal-panel
          - const: chipone,icna3512

      - items:
          - enum:
              - ayntec,odin3-panel
              - ayntec,thor-panel-top
          - const: chipone,icna3520

      - const: xiaomi,gold-panel-n17-36-0f-0c

  reg:
    maxItems: 1
    description: DSI virtual channel

  vdd-supply: true
  vddio-supply: true
  vci-supply: true
  disp-supply: true
  blvdd-supply: true

  port: true
  reset-gpios: true
  rotation: true

required:
  - compatible
  - reg
  - vdd-supply
  - vddio-supply
  - vci-supply
  - reset-gpios

additionalProperties: false

examples:
  - |
    #include <dt-bindings/gpio/gpio.h>

    dsi {
        #address-cells = <1>;
        #size-cells = <0>;
        panel@0 {
            compatible = "ayntec,odin2portal-panel", "chipone,icna3512";
            reg = <0>;
            vdd-supply = <&vreg_l11b_1p2>;
            vddio-supply = <&vreg_l12b_1p8>;
            vci-supply = <&vreg_l13b_3p0>;
            disp-supply = <&vdd_disp_2v8>;
            blvdd-supply = <&vdd_bl_5v0>;
            reset-gpios = <&tlmm 133 GPIO_ACTIVE_LOW>;
        };
    };

...
```

## Documentation/devicetree/bindings/dma/mediatek,mt6765-cqdma.yaml
```yaml
# SPDX-License-Identifier: (GPL-2.0-only OR BSD-2-Clause)
%YAML 1.2
---
$id: http://devicetree.org/schemas/dma/mediatek,mt6765-cqdma.yaml#
$schema: http://devicetree.org/meta-schemas/core.yaml#

title: MediaTek Command-Queue DMA Controller

maintainers:
  - Sean Wang <sean.wang@mediatek.com>

description:
  The Command-Queue DMA controller (CQDMA) is a memory-to-memory DMA engine
  with a few physical channels, each with its own registers and interrupt,
  that the driver spreads virtual channels over.

allOf:
  - $ref: dma-controller.yaml#

properties:
  compatible:
    oneOf:
      - const: mediatek,mt6765-cqdma
      - items:
          - enum:
              - mediatek,mt6833-cqdma
          - const: mediatek,mt6765-cqdma

  reg:
    description: The registers of each physical channel
    minItems: 1
    maxItems: 4

  interrupts:
    description: The interrupt of each physical channel
    minItems: 1
    maxItems: 4

  clocks:
    maxItems: 1

  clock-names:
    const: cqdma

  "#dma-cells":
    description: The virtual channel number
    const: 1

  dma-channels:
    description: The number of physical channels (3 if absent)
    minimum: 1
    maximum: 4

  dma-requests:
    description: The number of virtual channels (32 if absent)

required:
  - compatible
  - reg
  - interrupts
  - clocks
  - clock-names
  - "#dma-cells"

unevaluatedProperties: false

examples:
  - |
    #include <dt-bindings/clock/mediatek,mt6833-clk.h>
    #include <dt-bindings/interrupt-controller/arm-gic.h>
    #include <dt-bindings/interrupt-controller/irq.h>

    dma-controller@10212000 {
        compatible = "mediatek,mt6833-cqdma", "mediatek,mt6765-cqdma";
        reg = <0x10212000 0x80>, <0x10212100 0x80>,
              <0x10212200 0x80>, <0x10212300 0x80>;
        interrupts = <GIC_SPI 154 IRQ_TYPE_LEVEL_HIGH>,
                     <GIC_SPI 155 IRQ_TYPE_LEVEL_HIGH>,
                     <GIC_SPI 156 IRQ_TYPE_LEVEL_HIGH>,
                     <GIC_SPI 157 IRQ_TYPE_LEVEL_HIGH>;
        clocks = <&infracfg_ao CLK_IFRAO_CQ_DMA>;
        clock-names = "cqdma";
        dma-channels = <4>;
        dma-requests = <10>;
        #dma-cells = <1>;
    };
```

## Documentation/devicetree/bindings/input/touchscreen/focaltech,ft3683g.yaml
```yaml
# SPDX-License-Identifier: (GPL-2.0-only OR BSD-2-Clause)
%YAML 1.2
---
$id: http://devicetree.org/schemas/input/touchscreen/focaltech,ft3683g.yaml#
$schema: http://devicetree.org/meta-schemas/core.yaml#

title: FocalTech touchscreen controllers on SPI

maintainers:
  - Betterr <51264180+Star-caorui@users.noreply.github.com>

allOf:
  - $ref: touchscreen.yaml#
  - $ref: /schemas/spi/spi-peripheral-props.yaml#

properties:
  compatible:
    const: focaltech,ft3683g

  reg:
    maxItems: 1

  interrupts:
    maxItems: 1

  reset-gpios:
    maxItems: 1

  avdd-supply:
    description: Analog supply

  iovdd-supply:
    description: I/O supply

required:
  - compatible
  - reg
  - interrupts

unevaluatedProperties: false

examples:
  - |
    #include <dt-bindings/gpio/gpio.h>
    #include <dt-bindings/interrupt-controller/irq.h>

    spi {
        #address-cells = <1>;
        #size-cells = <0>;

        touchscreen@1 {
            compatible = "focaltech,ft3683g";
            reg = <1>;
            spi-max-frequency = <6000000>;
            interrupts-extended = <&pio 14 IRQ_TYPE_EDGE_FALLING>;
            reset-gpios = <&pio 15 GPIO_ACTIVE_LOW>;
            touchscreen-size-x = <1080>;
            touchscreen-size-y = <2400>;
        };
    };
```

## Documentation/devicetree/bindings/media/i2c/galaxycore,gc16b3.yaml
```yaml
# SPDX-License-Identifier: (GPL-2.0-only OR BSD-2-Clause)
%YAML 1.2
---
$id: http://devicetree.org/schemas/media/i2c/galaxycore,gc16b3.yaml#
$schema: http://devicetree.org/meta-schemas/core.yaml#

title: GalaxyCore GC16B3 16 Mpixel MIPI CSI-2 sensor

maintainers:
  - Rui Cao <i@udp0.com>

description:
  The GC16B3 is a raw Bayer image sensor with a four-lane MIPI CSI-2 D-PHY
  data interface and a CCI (I2C compatible) control bus.

allOf:
  - $ref: /schemas/media/video-interface-devices.yaml#

properties:
  compatible:
    const: galaxycore,gc16b3

  reg:
    maxItems: 1

  clocks:
    description: MCLK, 24 MHz.
    maxItems: 1

  dovdd-supply:
    description: Digital I/O supply, 1.8 V.

  dvdd-supply:
    description: Digital core supply, 1.2 V.

  avdd-supply:
    description: Analog supply, 2.8 V.

  reset-gpios:
    description: The RESETB pin, active low.
    maxItems: 1

  port:
    $ref: /schemas/graph.yaml#/$defs/port-base
    additionalProperties: false

    properties:
      endpoint:
        $ref: /schemas/media/video-interfaces.yaml#
        unevaluatedProperties: false

        properties:
          data-lanes:
            items:
              - const: 1
              - const: 2
              - const: 3
              - const: 4

          link-frequencies: true

        required:
          - data-lanes
          - link-frequencies

    required:
      - endpoint

required:
  - compatible
  - reg
  - clocks
  - dovdd-supply
  - dvdd-supply
  - avdd-supply
  - port

unevaluatedProperties: false

examples:
  - |
    #include <dt-bindings/gpio/gpio.h>

    i2c {
        #address-cells = <1>;
        #size-cells = <0>;

        camera-sensor@10 {
            compatible = "galaxycore,gc16b3";
            reg = <0x10>;
            clocks = <&camera_mclk>;
            reset-gpios = <&pio 54 GPIO_ACTIVE_LOW>;
            dovdd-supply = <&vcamio>;
            dvdd-supply = <&cam_dvdd>;
            avdd-supply = <&cam_avdd>;
            orientation = <0>;
            rotation = <270>;

            port {
                endpoint {
                    data-lanes = <1 2 3 4>;
                    link-frequencies = /bits/ 64 <181200000>;
                    remote-endpoint = <&csi_in>;
                };
            };
        };
    };
...
```
